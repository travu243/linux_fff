/dts-v1/;
/plugin/;

/ {
    compatible = "ti,beaglebone-black";

    fragment@0 {
        target-path = "/";
        __overlay__ {
            asm1: asm1 {
                compatible = "my-sensor";
                threshold = <36>;
                status = "okay";
            };

            gpio_led: gpio_led@0 {
                compatible = "my,gpio-led";
                gpios = <&gpio0 30 0>;//GPIO0_30(pin P9_11)
                status = "okay";
            };
        };
    };
};
