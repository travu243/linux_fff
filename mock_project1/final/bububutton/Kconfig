## mock_project1/final/bububutton/Kconfig
```kconfig
config BUBUBUTTON
    bool "BUBUBUTTON driver dang cap"
    help
      This adds a custom BUBUBUTTON driver.
```

## mock_project1/final/i2c_test/Kconfig
```kconfig
config I2C_TEST
    bool "I2C PCF8574 dang cap"
    help
      This add i2c driver comunication with pcf8574 to control led.
```

## mock_project1/final/ledledled/Kconfig
```kconfig
config LEDLEDLED
    bool "LEDLEDLED driver dang cap"
    help
      This adds a custom LEDLEDLED driver.
```
