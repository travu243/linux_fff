/dts-v1/;
/plugin/;

/ {
    compatible = "ti,beaglebone-black";

    fragment@0 {
        target-path = "/";
        __overlay__ {
            gpio_led: gpio_led@0 {
                compatible = "my,gpio-led";
                gpios = <&gpio0 30 0>; // GPIO0_30 = P9_11
                led-name = "status-led";
                status = "okay";
            };

            gpio_button: gpio_button@0 {
                compatible = "my,gpio-button";
                gpios = <&gpio1 28 0>; // GPIO1_28 = P9_12
                button-name = "user-button";
                status = "okay";
            };
        };
    };
};
